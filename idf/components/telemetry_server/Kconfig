## idf/components/telemetry_server/Kconfig
```kconfig
menu "ECU telemetry server"

    config TELEMETRY_SERVER_ENABLED
        bool "Enable WebSocket telemetry server"
        default y

    config TELEMETRY_SERVER_STA_SSID
        string "WiFi station SSID"
        default ""
        depends on TELEMETRY_SERVER_ENABLED

    config TELEMETRY_SERVER_STA_PASSWORD
        string "WiFi station password"
        default ""
        depends on TELEMETRY_SERVER_ENABLED

    config TELEMETRY_SERVER_HTTP_PORT
        int "HTTP/WebSocket port"
        default 80
        range 1 65535
        depends on TELEMETRY_SERVER_ENABLED

    config TELEMETRY_SERVER_STATE_HZ
        int "Telemetry state rate (Hz)"
        default 10
        range 1 50
        depends on TELEMETRY_SERVER_ENABLED

    config TELEMETRY_SERVER_MAX_EVENTS_PER_BATCH
        int "Maximum telemetry events per frame"
        default 8
        range 0 32
        depends on TELEMETRY_SERVER_ENABLED

    config TELEMETRY_SERVER_TASK_STACK_BYTES
        int "Telemetry pump task stack bytes"
        default 8192
        range 4096 32768
        depends on TELEMETRY_SERVER_ENABLED

    config TELEMETRY_SERVER_TASK_PRIORITY
        int "Telemetry pump task priority"
        default 2
        range 1 10
        depends on TELEMETRY_SERVER_ENABLED

    config DIGITAL_TWIN_HARDWARE_REVISION
        string "Digital twin hardware revision"
        default "ESP32-S3FH4R2"
        depends on TELEMETRY_SERVER_ENABLED

    config DIGITAL_TWIN_AUTO_RPM_THRESHOLD
        int "Digital twin auto-record RPM threshold"
        default 300
        range 0 30000
        depends on TELEMETRY_SERVER_ENABLED

    config DIGITAL_TWIN_AUTO_START_MS
        int "Digital twin auto-record start debounce (ms)"
        default 1000
        range 0 60000
        depends on TELEMETRY_SERVER_ENABLED

    config DIGITAL_TWIN_AUTO_STOP_MS
        int "Digital twin auto-record stop debounce (ms)"
        default 3000
        range 0 60000
        depends on TELEMETRY_SERVER_ENABLED

endmenu
```

## idf/main/Kconfig.projbuild
```kconfig
menu "ECU sensor harness"

    config SENSOR_HARNESS_ENABLE_UNCONFIRMED_REAL_INPUTS
        bool "Expose unconfirmed real sensor source options"
        default n
        help
            Enable this only while adding board wiring for sensors whose final
            ADC channels, GPIOs, SPI devices, or timing paths are not confirmed
            yet. Selecting one of those real sources intentionally stops the
            build until the matching binding is implemented.

    choice SENSOR_HARNESS_TPS_SOURCE
        prompt "TPS source"
        default SENSOR_HARNESS_TPS_SOURCE_FAKE

        config SENSOR_HARNESS_TPS_SOURCE_FAKE
            bool "Fake injected TPS"

        config SENSOR_HARNESS_TPS_SOURCE_REAL_ADC
            bool "Real ADC1_CH6 / GPIO7"
    endchoice

    choice SENSOR_HARNESS_WATER_SOURCE
        prompt "Water-temperature source"
        default SENSOR_HARNESS_WATER_SOURCE_FAKE

        config SENSOR_HARNESS_WATER_SOURCE_FAKE
            bool "Fake injected water temperature"

        config SENSOR_HARNESS_WATER_SOURCE_REAL_ADC
            bool "Real ADC NTC input (unconfirmed)"
            depends on SENSOR_HARNESS_ENABLE_UNCONFIRMED_REAL_INPUTS
    endchoice

    choice SENSOR_HARNESS_EGT_SOURCE
        prompt "EGT source"
        default SENSOR_HARNESS_EGT_SOURCE_FAKE

        config SENSOR_HARNESS_EGT_SOURCE_FAKE
            bool "Fake injected EGT"

        config SENSOR_HARNESS_EGT_SOURCE_REAL_MAX31856
            bool "Real MAX31856 SPI input (unconfirmed)"
            depends on SENSOR_HARNESS_ENABLE_UNCONFIRMED_REAL_INPUTS
    endchoice

    choice SENSOR_HARNESS_QUICK_SOURCE
        prompt "Quick-shifter source"
        default SENSOR_HARNESS_QUICK_SOURCE_FAKE

        config SENSOR_HARNESS_QUICK_SOURCE_FAKE
            bool "Fake injected quick-shifter"

        config SENSOR_HARNESS_QUICK_SOURCE_REAL_GPIO
            bool "Real GPIO9 input"
    endchoice

    choice SENSOR_HARNESS_MAP_SOURCE
        prompt "Map-switch source"
        default SENSOR_HARNESS_MAP_SOURCE_FAKE

        config SENSOR_HARNESS_MAP_SOURCE_FAKE
            bool "Fake injected map switch"

        config SENSOR_HARNESS_MAP_SOURCE_REAL_GPIO
            bool "Real GPIO14 input"
    endchoice

    choice SENSOR_HARNESS_PICKUP_SOURCE
        prompt "Pickup source"
        default SENSOR_HARNESS_PICKUP_SOURCE_FAKE

        config SENSOR_HARNESS_PICKUP_SOURCE_FAKE
            bool "Fake injected pickup edges"

        config SENSOR_HARNESS_PICKUP_SOURCE_REAL_CAPTURE
            bool "Real GPIO21 MCPWM falling-edge capture"
    endchoice

    choice SENSOR_HARNESS_KNOCK_SOURCE
        prompt "Knock source"
        default SENSOR_HARNESS_KNOCK_SOURCE_FAKE

        config SENSOR_HARNESS_KNOCK_SOURCE_FAKE
            bool "Fake injected knock window result"

        config SENSOR_HARNESS_KNOCK_SOURCE_REAL_TPIC8101
            bool "Real TPIC8101 window device (unconfirmed)"
            depends on SENSOR_HARNESS_ENABLE_UNCONFIRMED_REAL_INPUTS
    endchoice

endmenu
```

## idf/sdkconfig.defaults
```kconfig
CONFIG_IDF_TARGET="esp32s3"
CONFIG_ESPTOOLPY_FLASHSIZE_2MB=y
CONFIG_PARTITION_TABLE_CUSTOM=y
CONFIG_PARTITION_TABLE_CUSTOM_FILENAME="partitions.csv"
CONFIG_PARTITION_TABLE_FILENAME="partitions.csv"
CONFIG_SPIFFS_OBJ_NAME_LEN=64
CONFIG_HTTPD_WS_SUPPORT=y
CONFIG_ESP_SYSTEM_EVENT_TASK_STACK_SIZE=4096
CONFIG_FREERTOS_USE_LIST_DATA_INTEGRITY_CHECK_BYTES=y
CONFIG_FREERTOS_WATCHPOINT_END_OF_STACK=y
# CONFIG_HEAP_POISONING_DISABLED is not set
CONFIG_HEAP_POISONING_LIGHT=y
# CONFIG_HEAP_POISONING_COMPREHENSIVE is not set
```

## test-bench/sdkconfig.defaults
```kconfig
CONFIG_IDF_TARGET="esp32s2"
CONFIG_ESPTOOLPY_FLASHSIZE_2MB=y
CONFIG_PARTITION_TABLE_CUSTOM=y
CONFIG_PARTITION_TABLE_CUSTOM_FILENAME="partitions.csv"
CONFIG_PARTITION_TABLE_FILENAME="partitions.csv"
CONFIG_HTTPD_WS_SUPPORT=y
CONFIG_SPIFFS_OBJ_NAME_LEN=64
CONFIG_GPIO_CTRL_FUNC_IN_IRAM=y
CONFIG_GPTIMER_ISR_HANDLER_IN_IRAM=y
CONFIG_GPTIMER_CTRL_FUNC_IN_IRAM=y
CONFIG_GPTIMER_ISR_CACHE_SAFE=y
```
